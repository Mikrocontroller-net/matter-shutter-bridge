## main/Kconfig.projbuild
```kconfig
menu "Fernomatter"

config FERNO_BRIDGE_LAYOUT
    bool "Expose shutters as bridged devices under an Aggregator"
    default y
    help
        On: one Aggregator endpoint plus one bridged Window Covering per
        shutter, each with its own name. Off: one standalone Window Covering
        endpoint per shutter. Switching after pairing requires re-pairing.

endmenu
```
